## main/Kconfig.projbuild
```kconfig
menu "WiFiControlBase"
    config LED_PIN
        int "LED GPIO number"
        default 5

    menu "LED controle conf"
        config LED1_PIN
            int "LED1 GPIO number"
            default 26

        config LED2_PIN
            int "LED2 GPIO number"
            default 27

        config LED3_PIN
            int "LED3 GPIO number"
            default 32

        config LED4_PIN
            int "LED4 GPIO number"
            default 33
    endmenu

    menu "Servo controle conf"
        config SERVO_PIN
            int "Servo GPIO number"
            default 12
    endmenu

    menu "SD card PIN configuration"
    
        config MOSI_PIN
            int "MOSI GPIO number"
            default 17
        
        config MISO_PIN
            int "MOSO GPIO number"
            default 19

        config CLK_PIN
            int "CLK GPIO number"
            default 18

        config CS_PIN
            int "CS GPIO number"
            default 16

        config CARD_SW_PIN
            int "SD card sw GPIO number"
            default 4
    endmenu

    menu "OLED(SSD1306) PIN configuration"
        config SDA_PIN
            int "I2C SDA GPIO number"
            default 21

        config SCL_PIN
            int "I2C SCL GPIO number"
            default 22
    endmenu

endmenu
```
